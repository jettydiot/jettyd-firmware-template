## sdkconfig.defaults
```kconfig
# ── jettyd provisioning ──────────────────────────────────────────────────────
# ⚠️  Auto-synced from device.yaml by build.py — edit device.yaml, not this file
CONFIG_JETTYD_FLEET_TOKEN="ft_YOUR_TOKEN_HERE"
CONFIG_JETTYD_MQTT_URI="mqtt://mqtt.jettyd.com:1883"
CONFIG_JETTYD_FIRMWARE_VERSION="1.0.0"
CONFIG_JETTYD_DEVICE_TYPE="esp32-generic"

# ── WiFi ─────────────────────────────────────────────────────────────────────
# ⚠️  Auto-synced from device.yaml wifi.ssid / wifi.password
CONFIG_JETTYD_WIFI_SSID="YourNetworkName"
CONFIG_JETTYD_WIFI_PASSWORD="YourNetworkPassword"

# ── Heartbeat ─────────────────────────────────────────────────────────────────
# heartbeat_interval in device.yaml is in SECONDS (e.g. 60 = 1 minute).
# report_metrics lists dot-namespaced metrics to publish on each heartbeat.
# Telemetry fires immediately on connect, then repeats at the interval.

# ── Target chip ───────────────────────────────────────────────────────────────
# Controlled by the 'target' field in device.yaml.
# CMakeLists.txt reads device.yaml and sets IDF_TARGET automatically.
# Supported: esp32s3, esp32c3, esp32c6
# Note: Original ESP32 (non-S3/C3/C6) is NOT supported.
CONFIG_IDF_TARGET="esp32s3"

# ── ESP-IDF tunables ──────────────────────────────────────────────────────────
CONFIG_ESP_SYSTEM_EVENT_TASK_STACK_SIZE=6144
CONFIG_MQTT_TASK_STACK_SIZE=6144
CONFIG_ESP_MAIN_TASK_STACK_SIZE=8192
CONFIG_FREERTOS_IDLE_TASK_STACKSIZE=1536

# ── Flash & Partition ────────────────────────────────────────────────────────
CONFIG_ESPTOOLPY_FLASHSIZE_4MB=y
CONFIG_PARTITION_TABLE_CUSTOM=y
CONFIG_PARTITION_TABLE_CUSTOM_FILENAME="partitions.csv"
CONFIG_PARTITION_TABLE_OFFSET=0x8000

# ── OTA ───────────────────────────────────────────────────────────────────────
CONFIG_BOOTLOADER_APP_ROLLBACK_ENABLE=y
```
